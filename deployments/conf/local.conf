## deployments/conf/local.conf
```bitbake
include "application"

akka {
  loglevel = DEBUG
  loggers = ["akka.event.slf4j.Slf4jLogger"]
  logger-startup-timeout = 10s

  actor {
    provider = "akka.cluster.ClusterActorRefProvider"
  }

  debug {
    receive = off
    unhandled = on
  }

  remote {
    log-remote-lifecycle-events = off
    netty.tcp {
      hostname = "127.0.0.1"
      port = 0
    }
  }

  cluster {
    seed-nodes = ["akka.tcp://ClusterSystem@127.0.0.1:2551"]
    #roles = ["case-domain"]
    auto-down-unreachable-after = 30s
  }

  persistence {
    journal {
      # DO NOT USE LEVELDB FOR A MULTI NODE SETUP !!!
      plugin = "akka.persistence.journal.leveldb"

      leveldb {
        store {
          # DO NOT USE 'native = off' IN PRODUCTION !!!
          native = off
          dir = "journal"
        }

        event-adapters {
          tagging = "org.cafienne.cmmn.instance.journal.CaseTaggingEventAdapter"
        }

        event-adapter-bindings {
          "org.cafienne.cmmn.instance.CaseInstanceEvent" = tagging
        }
      }
    }
  }

  cluster {
    sharding {
      # The extension creates a top level actor with this name in top level user scope,
      # e.g. '/user/sharding'
      guardian-name = sharding
      # If the coordinator can't store state changes it will be stopped
      # and started again after this duration.
      coordinator-failure-backoff = 10 s
      # Start the coordinator singleton manager on members tagged with this role.
      # All members are used if undefined or empty.
      # ShardRegion actor is started in proxy only mode on nodes that are not tagged
      # with this role.

      #role = "case-domain"
      #role = "domain"

      # The ShardRegion retries registration and shard location requests to the
      # ShardCoordinator with this interval if it does not reply.
      retry-interval = 2 s
      # Maximum number of messages that are buffered by a ShardRegion actor.
      buffer-size = 100000
      # Timeout of the shard rebalancing process.
      handoff-timeout = 60 s
      # Rebalance check is performed periodically with this interval.
      rebalance-interval = 10 s
      # How often the coordinator saves persistent snapshots, which are
      # used to reduce recovery times
      snapshot-interval = 3600 s
      # Setting for the default shard allocation strategy
      least-shard-allocation-strategy {
        # Threshold of how large the difference between most and least number of
        # allocated shards must be to begin the rebalancing.
        rebalance-threshold = 10
        # The number of ongoing rebalancing processes is limited to this number.
        max-simultaneous-rebalance = 3
      }
    }
  }


}

cafienne {
  api {
    bindhost = "0.0.0.0"
    bindport = 18082

    security {
      shared-secret = "234#dsfDG6!KKl81m?r7BHa02"
      auth-header-name = "X-AUTH-CAFIENNE"
    }
  }

  elasticsearch {
    cluster.name = "cafienne"
    # comma seperated list of ES hosts in a cluster in the format <host1>:<port1>,<host2>:<port2>
    host-list = "elastic:9300"
    client.transport.ignore_cluster_name = true
    #client.transport.sniff = true
    #discovery.zen.ping.multicast.enabled = true
    #discovery.zen.ping.multicast.ping.enabled = false
    #discovery.zen.ping.unicast.hosts = ["80.79.203.63:9300"]
  }

}
```
